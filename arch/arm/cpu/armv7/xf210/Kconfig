## arch/arm/cpu/armv7/xf210/Kconfig
```kconfig
if SOC_XF210

choice
	prompt "xf210 board select"
	optional

config TARGET_TQ210
	bool "tq210 Machine"

endchoice



source "board/tq210/Kconfig"

endif
```

## board/tq210/Kconfig
```kconfig
if TARGET_TQ210

config SYS_BOARD
	default "tq210"

config SYS_VENDOR
	default ""

config SYS_SOC
	default "xf210"

config SYS_CONFIG_NAME
	default "tq210"

endif
```

## board/tq2440/Kconfig
```kconfig
if TARGET_TQ2440

config SYS_BOARD
	default "tq2440"
	
config SYS_VENDOR
	default ""

config SYS_SOC
	default "xf2440"

config SYS_CONFIG_NAME
	default "tq2440"
	
config XF2440
	bool 
	default y



endif
```

## cmd/fastboot/Kconfig
```kconfig
comment "FASTBOOT"

menuconfig FASTBOOT
	bool "Fastboot support"

if FASTBOOT

config USB_FUNCTION_FASTBOOT
	bool "Enable USB fastboot gadget"
	help
	  This enables the USB part of the fastboot gadget.

config CMD_FASTBOOT
	bool "Enable FASTBOOT command"
	help
	  This enables the command "fastboot" which enables the Android
	  fastboot mode for the platform's USB device. Fastboot is a USB
	  protocol for downloading images, flashing and device control
	  used on Android devices.

	  See doc/README.android-fastboot for more information.

config ANDROID_BOOT_IMAGE
	bool "Enable support for Android Boot Images"
	help
	  This enables support for booting images which use the Android
	  image format header.

if USB_FUNCTION_FASTBOOT

config FASTBOOT_BUF_ADDR
	hex "Define FASTBOOT buffer address"
	help
	  The fastboot protocol requires a large memory buffer for
	  downloads. Define this to the starting RAM address to use for
	  downloaded images.

config FASTBOOT_BUF_SIZE
	hex "Define FASTBOOT buffer size"
	help
	  The fastboot protocol requires a large memory buffer for
	  downloads. This buffer should be as large as possible for a
	  platform. Define this to the size available RAM for fastboot.

config FASTBOOT_USB_DEV
	int "USB controller number"
	default 0
	help
	  Some boards have USB OTG controller other than 0. Define this
	  option so it can be used in compiled environment (e.g. in
	  CONFIG_BOOTCOMMAND).

config FASTBOOT_FLASH
	bool "Enable FASTBOOT FLASH command"
	help
	  The fastboot protocol includes a "flash" command for writing
	  the downloaded image to a non-volatile storage device. Define
	  this to enable the "fastboot flash" command.



endif # USB_FUNCTION_FASTBOOT

endif # FASTBOOT
```

## configs/tq210_defconfig
```kconfig
CONFIG_ARM=y
CONFIG_SOC_XF210=y
CONFIG_TARGET_TQ210=y
# CONFIG_LOCALVERSION_AUTO is not set
CONFIG_NAND_BOOT=y
CONFIG_USE_BOOTARGS=y
CONFIG_BOOTARGS="console=ttySAC0,115200 ubi.mtd=1 ubi.mtd=2 root=ubi1:rootfs rootfstype=ubifs"
# CONFIG_DISPLAY_CPUINFO is not set
CONFIG_SYS_PROMPT="TQ210# "
CONFIG_FASTBOOT=y
CONFIG_USB_FUNCTION_FASTBOOT=y
CONFIG_CMD_FASTBOOT=y
CONFIG_ANDROID_BOOT_IMAGE=y
CONFIG_FASTBOOT_BUF_ADDR=0x20007fc0
CONFIG_FASTBOOT_BUF_SIZE=0x10000000
CONFIG_FASTBOOT_FLASH=y
CONFIG_CMD_BOOTZ=y
# CONFIG_CMD_IMI is not set
# CONFIG_CMD_IMLS is not set
# CONFIG_CMD_XIMG is not set
CONFIG_CMD_GREPENV=y
# CONFIG_CMD_NET is not set
# CONFIG_CMD_NFS is not set
CONFIG_CMD_UBI=y
CONFIG_ENV_IS_IN_NAND=y
# CONFIG_MMC is not set
CONFIG_MTD_DEVICE=y
CONFIG_NAND=y
CONFIG_NAND_TQ210=y
CONFIG_TQ210_SERIAL=y
CONFIG_USB=y
CONFIG_USB_GADGET=y
CONFIG_USB_GADGET_DWC2_OTG=y
CONFIG_USB_GADGET_DOWNLOAD=y
CONFIG_G_DNL_MANUFACTURER="Wust"
CONFIG_G_DNL_VENDOR_NUM=0x18d1
CONFIG_G_DNL_PRODUCT_NUM=0x1535
CONFIG_REGEX=y
CONFIG_OF_LIBFDT=y
```

## configs/tq2440_defconfig
```kconfig
CONFIG_ARM=y
CONFIG_TARGET_TQ2440=y
# CONFIG_LOCALVERSION_AUTO is not set
CONFIG_USE_BOOTARGS=y
CONFIG_BOOTARGS="console=ttySAC0,115200 ubi.mtd=2 root=ubi0:rootfs rootfstype=ubifs"
CONFIG_SYS_PROMPT="TQ2440# "
CONFIG_FASTBOOT=y
CONFIG_USB_FUNCTION_FASTBOOT=y
CONFIG_CMD_FASTBOOT=y
CONFIG_FASTBOOT_BUF_ADDR=0x30007fc0
CONFIG_FASTBOOT_BUF_SIZE=0x07000000
CONFIG_FASTBOOT_FLASH=y
CONFIG_CMD_BOOTZ=y
# CONFIG_CMD_IMI is not set
# CONFIG_CMD_IMLS is not set
# CONFIG_CMD_XIMG is not set
# CONFIG_CMD_FLASH is not set
# CONFIG_CMD_FPGA is not set
# CONFIG_CMD_NFS is not set
CONFIG_CMD_UBI=y
CONFIG_ENV_IS_IN_NAND=y
# CONFIG_MMC is not set
CONFIG_NAND=y
CONFIG_NAND_XF2440=y
CONFIG_XF2440_SERIAL=y
CONFIG_USB=y
CONFIG_USB_GADGET=y
CONFIG_USB_GADGET_XF2440=y
CONFIG_USB_GADGET_DOWNLOAD=y
CONFIG_G_DNL_MANUFACTURER="Wust"
CONFIG_G_DNL_VENDOR_NUM=0x18d1
CONFIG_G_DNL_PRODUCT_NUM=0x2440
CONFIG_OF_LIBFDT=y
```
